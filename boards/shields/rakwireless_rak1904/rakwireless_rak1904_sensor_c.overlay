/*
 * SPDX-License-Identifier: Apache-2.0
 * Copyright (c) 2026 RAKwireless Technology Limited
 */

#include "rakwireless_rak1904_common.dtsi"

&rak1904_lis3dh {
	irq-gpios = <&wisblock_sensor_c WISBLOCK_SENSOR_GPIO2 GPIO_ACTIVE_HIGH>,
		    <&wisblock_sensor_c WISBLOCK_SENSOR_GPIO1 GPIO_ACTIVE_HIGH>;
};
